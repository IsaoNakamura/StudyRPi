#include <Wire.h>
#include <SeeedOLED.h>
#include <avr/pgmspace.h>
#include <Servo.h>

static const unsigned char TamiyaLogo_pause[] PROGMEM ={
0xff, 0xff, 0xff, 0xff, 0xff, 0xff, 0xff, 0xff, 0xff, 0xff, 0xff, 0xff, 0xff, 0xff, 0xff, 0xff,
 0xff, 0xff, 0xff, 0xff, 0xff, 0xff, 0xff, 0xff, 0xff, 0xff, 0xff, 0xff, 0xff, 0xff, 0xff, 0xff,
 0xff, 0xff, 0xff, 0xff, 0xff, 0xff, 0xff, 0xff, 0xff, 0x7f, 0x7f, 0x7f, 0x7f, 0x3f, 0x3f, 0x3f,
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 0x83, 0x86, 0x80, 0xff, 0x80, 0x99, 0xb9, 0xb9, 0xf9, 0xf9, 0xf9, 0xf9, 0xf9, 0xf9, 0xe0, 0xff
};

static const unsigned char TamiyaLogo_ff[] PROGMEM ={
0xff, 0x1f, 0x1f, 0x0f, 0x07, 0x07, 0x07, 0x07, 0x07, 0x07, 0x0f, 0x0f, 0x1f, 0x1f, 0x1f, 0x1f,
 0x3f, 0xff, 0xff, 0xff, 0xff, 0xff, 0xff, 0xff, 0xff, 0xff, 0xff, 0xff, 0xff, 0xff, 0xff, 0xff,
 0xff, 0xff, 0xff, 0xff, 0xff, 0xff, 0xff, 0xff, 0xff, 0xff, 0xff, 0xff, 0xff, 0xff, 0xff, 0xff,
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 0x83, 0x86, 0x80, 0xff, 0x80, 0x99, 0xb9, 0xb9, 0xf9, 0xf9, 0xf9, 0xf9, 0xf9, 0xf9, 0xe0, 0xff
};

static const unsigned char TamiyaLogo_rewind[] PROGMEM ={
 0xff, 0xff, 0xff, 0xff, 0xff, 0xff, 0xff, 0xff, 0xff, 0xff, 0xff, 0xff, 0xff, 0xff, 0xff, 0xff,
 0xff, 0xff, 0xff, 0xff, 0xff, 0xff, 0xff, 0xff, 0xff, 0xff, 0xff, 0xff, 0xff, 0x7f, 0x7f, 0x1f,
 0x1f, 0x0f, 0x0f, 0x0f, 0x0f, 0x0f, 0x0f, 0x0f, 0x07, 0x07, 0x07, 0x07, 0x03, 0x03, 0x03, 0x03,
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 0x83, 0x86, 0x80, 0xff, 0x80, 0x99, 0xb9, 0xb9, 0xf9, 0xf9, 0xf9, 0xf9, 0xf9, 0xf9, 0xe0, 0xff
};

static const unsigned char TamiyaLogo_stop[] PROGMEM ={
 0xff, 0xff, 0xff, 0xff, 0x03, 0x03, 0x01, 0x00, 0x00, 0x00, 0x00, 0x00, 0x00, 0x01, 0x01, 0x03,
 0x03, 0x03, 0x03, 0x07, 0x1f, 0x3f, 0x3f, 0x7f, 0xff, 0xff, 0xff, 0xff, 0xff, 0xff, 0xff, 0xff,
 0xff, 0xff, 0xff, 0xff, 0xff, 0xff, 0xff, 0xff, 0xff, 0xff, 0xff, 0xff, 0xff, 0xff, 0xff, 0xff,
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 0x83, 0x86, 0x80, 0xff, 0x80, 0x99, 0xb9, 0xb9, 0xf9, 0xf9, 0xf9, 0xf9, 0xf9, 0xf9, 0xe0, 0xff
};

#define PIN_FORWARD     8
#define PIN_BACKWARD    9

#define DRIVE_MSEC  3000 //30000
#define PAUSE_MSEC  2000 //180000
#define HIDEN_MSEC  5000

Servo myservo;
int pos = 0;

unsigned long g_splitTime = 0;
int g_motor_state = -1; // -1:stop 0:forward 1:pause_forward 2:backward 3:pause_backward
int g_loop_num = 0;

void setup() {
  Wire.begin();
  SeeedOled.init();  //initialze SEEED OLED display

  SeeedOled.clearDisplay();          //clear the screen and set start position to top left corner
  //SeeedOled.setNormalDisplay();      //Set display to normal mode (i.e non-inverse mode)
  SeeedOled.setPageMode();           //Set addressing mode to Page Mode
  SeeedOled.setTextXY(0,0);          //Set the cursor to Xth Page, Yth Column  
  //SeeedOled.putString("Hello World!"); //Print the String
  //SeeedOled.setInverseDisplay();
  SeeedOled.drawBitmap((unsigned char*) TamiyaLogo_stop,1024);   // 1024 = 128 Pixels * 64 Pixels / 8

  pinMode(PIN_FORWARD, OUTPUT);
  pinMode(PIN_BACKWARD, OUTPUT);

  // STOP
  digitalWrite(PIN_FORWARD, LOW);
  digitalWrite(PIN_BACKWARD, LOW);

  myservo.attach( 10 );
  myservo.write(65);//65

  g_splitTime = millis();

}

void loop() {
  // get current time.
  unsigned long curTime = millis();
  unsigned long timeInterval = 0;
  if(curTime >= g_splitTime){
    timeInterval = curTime - g_splitTime;
  }

  // calc current motor_state
  int motor_state = g_motor_state;
  bool isChanged = calcCurrentMotorState(motor_state, g_motor_state, curTime, timeInterval);
  if( isChanged ){
    g_splitTime = curTime;
  }

  // action by motor_state.
  actionMotor(g_loop_num, motor_state, isChanged);

  // update g_motor_state.
  if( isChanged ){
    g_motor_state = motor_state;
  }

  delay(0);
}

void actionMotor
(
  int& loop_num,
  const int motor_state,
  const bool isChanged
)
{
  if(motor_state == 0 ){
    // FORWARD
    if(isChanged){
      // SeeedOled.clearDisplay();
      SeeedOled.setTextXY(0,0);
      SeeedOled.drawBitmap((unsigned char*) TamiyaLogo_ff,1024);
      SeeedOled.putString("FORWARD");
      digitalWrite(PIN_FORWARD, HIGH);
      digitalWrite(PIN_BACKWARD, LOW);
      myservo.write(95);
    }
  }else if(motor_state == 2){
    // BACKWARD
    if(isChanged){
      // SeeedOled.clearDisplay();
      SeeedOled.setTextXY(0,0);
      SeeedOled.drawBitmap((unsigned char*) TamiyaLogo_rewind,1024);
      SeeedOled.putString("BACKWARD");
      digitalWrite(PIN_FORWARD, LOW);
      digitalWrite(PIN_BACKWARD, HIGH);
      myservo.write(65);
    }
  }else if(motor_state == 1 || motor_state == 3){
    // PAUSE
    if(isChanged){
      // SeeedOled.clearDisplay();
      SeeedOled.setTextXY(0,0);
      SeeedOled.drawBitmap((unsigned char*) TamiyaLogo_pause,1024);
      SeeedOled.putString("PAUSE");
      digitalWrite(PIN_FORWARD, LOW);
      digitalWrite(PIN_BACKWARD, LOW);
      myservo.write(95);
      if(motor_state == 3){
        loop_num++;
      }
    }
  }else{
    // STOP
    if(isChanged){
      // SeeedOled.clearDisplay();
      SeeedOled.setTextXY(0,0);
      SeeedOled.drawBitmap((unsigned char*) TamiyaLogo_stop,1024);
      SeeedOled.putString("STOP");
      digitalWrite(PIN_FORWARD, LOW);
      digitalWrite(PIN_BACKWARD, LOW);
      myservo.write(65);
    }
  }
  return;
}

bool calcCurrentMotorState
(
  int& motor_state,
  const int prev_motor_state,
  const unsigned long curTime,
  const unsigned long timeInterval

) 
{
  bool bRet = false;

  // this frame motor_stae
  motor_state = prev_motor_state;
  
  // calc current motor_state
  if(prev_motor_state==-1){ // -1:stop
    if( timeInterval > HIDEN_MSEC){
      bRet = true;

      // stop to forward
      motor_state = 0;
    }
  }else 
  if(prev_motor_state==0 || prev_motor_state==2){ // 0:forward 2:backward
    if( timeInterval > DRIVE_MSEC){
      bRet = true;

      if(prev_motor_state == 0 ){
        // forward to pause
        motor_state = 1;
      }else{
        // backward to pause
        motor_state = 3;
      }
    }
  }else if(prev_motor_state==1 || prev_motor_state==3){ // 1:pause_forward or 3:pause_backward
    if( timeInterval > PAUSE_MSEC){
      bRet = true;

      if(prev_motor_state == 1 ){
        // pause to backward
        motor_state = 2;
      }else{
        // pause to forward
        motor_state = 0;
      }
    }
  }
  return bRet;
}
